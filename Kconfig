## Kconfig
```kconfig
menu "Hardware Drivers Config"

menu "Onboard Peripheral Drivers"

    config BSP_USING_USB_TO_USART
        bool "Enable USB TO USART (uart1)"
        select BSP_USING_UART
        select BSP_USING_UART1
        default y

    config BSP_USING_EEPROM
        bool "Enable I2C EEPROM (i2c1)"
        select BSP_USING_I2C1
        default n

    config BSP_USING_SPI_FLASH
        bool "Enable SPI FLASH (W25Q16 spi2)"
    select BSP_USING_SPI
        select BSP_USING_SPI2
        select RT_USING_SFUD
        select RT_SFUD_USING_SFDP
        default n

    config BSP_USING_POT
        bool "Enable potentiometer"
        select BSP_USING_ADC
        select BSP_USING_ADC1
        default n

    config BSP_USING_EXT_SRAM
        bool "Enable external sram"
        default n
        help
             Chip name is IS62WV51216, 1Mbytes static RAMs organized as 512K words by 16bits.

    config BSP_USING_SDCARD
        bool "Enable SDCARD (sdio)"
        select BSP_USING_SDIO
        select RT_USING_DFS
        select RT_USING_DFS_ELMFAT
        default n

endmenu

menu "On-chip Peripheral Drivers"

    config BSP_USING_GPIO
        bool "Enable GPIO"
        select RT_USING_PIN
        default y

    menuconfig BSP_USING_UART
        bool "Enable UART"
        default y
        select RT_USING_SERIAL
        if BSP_USING_UART
            config BSP_USING_UART1
                bool "Enable UART1"
                default y

            config BSP_UART1_RX_USING_DMA
                bool "Enable UART1 RX DMA"
                depends on BSP_USING_UART1 && RT_SERIAL_USING_DMA
                default n

            config BSP_USING_UART2
                bool "Enable UART2"
                default n

            config BSP_UART2_RX_USING_DMA
                bool "Enable UART2 RX DMA"
                depends on BSP_USING_UART2 && RT_SERIAL_USING_DMA
                default n

            config BSP_USING_UART3
                bool "Enable UART3"
                default n

            config BSP_UART3_RX_USING_DMA
                bool "Enable UART3 RX DMA"
                depends on BSP_USING_UART3 && RT_SERIAL_USING_DMA
                default n
        endif

    menuconfig BSP_USING_TIM
        bool "Enable timer"
        default n
        select RT_USING_HWTIMER
        if BSP_USING_TIM
            config BSP_USING_TIM2
                bool "Enable TIM2"
                default n
				if BSP_USING_TIM2
					config BSP_USING_TIM2_CH1
						bool "Enable TIM2 channel1 (PA15)"
						default n
					
					config BSP_USING_TIM2_CH2
						bool "Enable TIM2 channel2 (PB3)"
						default n

					config BSP_USING_TIM2_CH3
						bool "Enable TIM2 channel3 (PB10)"
						default n
					
					config BSP_USING_TIM2_CH4
						bool "Enable TIM2 channel4 (PB11)"
						default n
				endif	

            config BSP_USING_TIM8
                bool "Enable TIM8"
                default n
				if BSP_USING_TIM8
					config BSP_USING_TIM8_CH3
						bool "Enable TIM8 channel3 (PC8)"
						default n
					
					config BSP_USING_TIM8_CH4
						bool "Enable TIM8 channel4 (PC9)"
						default n
					help
						This timer is conficted with SDIO(PC6-9).
				endif	

        endif

    menuconfig BSP_USING_PWM
        bool "Enable PWM"
        default n
        select RT_USING_PWM
        if BSP_USING_PWM
        menuconfig BSP_USING_PWM5
            bool "Enable timer5 output PWM"
            default n
            if BSP_USING_PWM5
                config BSP_USING_PWM5_CH3
                    bool "Enable PWM5 channel3 (PA2)"
                    default n

                config BSP_USING_PWM5_CH4
                    bool "Enable PWM5 channel4 (PA3)"
                    default n
            endif
        endif
		
	menuconfig BSP_USING_PULSE_ENCODER
        bool "Enable pulse encoder"
        default n
        select RT_USING_PULSE_ENCODER
        if BSP_USING_PULSE_ENCODER
			config BSP_USING_PULSE_ENCODER3
				bool "Enable timer3 pulse encoder(PC6 PC7)"
				default n
				
			help
				this pulse encoder is conficted with SDIO(PC6-9).
			
        endif	

    menuconfig BSP_USING_SPI
        bool "Enable SPI BUS"
        default n
        select RT_USING_SPI
        if BSP_USING_SPI
            config BSP_USING_SPI1
                bool "Enable SPI1 BUS"
                default n

            config BSP_SPI1_TX_USING_DMA
                bool "Enable SPI1 TX DMA"
                depends on BSP_USING_SPI1
                default n

            config BSP_SPI1_RX_USING_DMA
                bool "Enable SPI1 RX DMA"
                depends on BSP_USING_SPI1
                select BSP_SPI1_TX_USING_DMA
                default n

            config BSP_USING_SPI2
                bool "Enable SPI2 BUS"
                default n

            config BSP_SPI2_TX_USING_DMA
                bool "Enable SPI2 TX DMA"
                depends on BSP_USING_SPI2
                default n

            config BSP_SPI2_RX_USING_DMA
                bool "Enable SPI2 RX DMA"
                depends on BSP_USING_SPI2
                select BSP_SPI2_TX_USING_DMA
                default n
        endif

    menuconfig BSP_USING_I2C1
        bool "Enable I2C1 BUS (software simulation)"
        default n
        select RT_USING_I2C
        select RT_USING_I2C_BITOPS
        select RT_USING_PIN
        if BSP_USING_I2C1
            config BSP_I2C1_SCL_PIN
                int "i2c1 scl pin number"
                range 0 63
                default 22
            config BSP_I2C1_SDA_PIN
                int "I2C1 sda pin number"
                range 0 63
                default 23
        endif

    menuconfig BSP_USING_ADC
        bool "Enable ADC"
        default n
        select RT_USING_ADC
        if BSP_USING_ADC
            config BSP_USING_ADC1
                bool "Enable ADC1 (PA1)"
                default n
        endif
	
	menuconfig BSP_USING_DAC
		bool "Enable DAC"
		default n
		select RT_USING_DAC
		if BSP_USING_DAC
			config BSP_USING_DAC1
				bool "Enable DAC1 (PA4)"
				default n
		endif
		
    menuconfig BSP_USING_CAN
        bool "Enable CAN"
        default n
        select RT_USING_CAN
        if BSP_USING_CAN
            config BSP_USING_CAN1
                bool "Enable CAN1"
                default n
            config BSP_USING_CAN2
                bool "Enable CAN2"
                default n
        endif
    config BSP_USING_ON_CHIP_FLASH
        bool "Enable on-chip FLASH"
        default n

    menuconfig BSP_USING_ONCHIP_RTC
        bool "Enable RTC"
        select RT_USING_RTC
        default n
        if BSP_USING_ONCHIP_RTC
            choice
                prompt "Select clock source"
                default BSP_RTC_USING_LSE

                config BSP_RTC_USING_LSE
                    bool "RTC USING LSE"

                config BSP_RTC_USING_LSI
                    bool "RTC USING LSI"
            endchoice
        endif

    config BSP_USING_WDT
        bool "Enable Watchdog Timer"
        select RT_USING_WDT
        default n

    config BSP_USING_SDIO
        bool "Enable SDIO"
        select RT_USING_SDIO
        default n
	 source "$(BSP_DIR)/../libraries/HAL_Drivers/drivers/Kconfig"
endmenu

menu "Board extended module Drivers"
	menuconfig BSP_USING_LCD
		bool "Enable LCD"
		select RT_USING_PIN
		select RT_USING_TOUCH
		select BSP_USING_EXT_SRAM
		default y
	
endmenu
endmenu
```
